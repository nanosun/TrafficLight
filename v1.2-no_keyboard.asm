;;------------------------
;;TrafLight v1.3
;;by SN icetiny@gmail.com
;;2011-6-8
;;将显示程序也改为通用程序，值存储在38H,地址存储在39H
;;------------------------
;;R0	 R1			  R2			  R3 			R6		  R7
;;灯状态 临时使用 2红灯倒计时	  1绿灯倒计时    秒状态数码	 分状态
;;------------------------
;;30H  31H  32H-35H	   36H            37H			38H		 39H	  
;;绿灯 红灯	灯状态地址 减一用  当前小时状态码  LED显示寄存器 数码管地址高八位
;;------------------------
;;40H-6FH
;;用户定义灯状态
;;------------------------
		ORG 0000H
		AJMP MAIN
;INTERRUPT VECTORS
		ORG 000BH							
		AJMP INT_TO							
		;ORG 0013H							
		;AJMP INT_EX1							
		ORG 001BH							
		AJMP INT_C1							
;DEFINE CONSTANT VALUE
		LDD1 EQU 00H ;数码管地址
		LDD2 EQU 01H
		LDD3 EQU 02H
		LDD4 EQU 03H
		LDD5 EQU 04H
		LDD6 EQU 05H
		LED  EQU 06H ;灯地址
		G_R1 EQU 1100B
		Y_R2 EQU 1010B
		R_G3 EQU 100001B
		R_Y4 EQU 10001B
		SECS_PER_MIN EQU 2 ;每分中的秒数，调试用
		MINS_PER_HOUR EQU 5 ;每小时中的分数，调试用																							
	
;MAIN PROGRAM BEGIN
		ORG 0030H
MAIN:	
		MOV SP,#10H
		MOV 32H,#G_R1
		MOV 33H,#Y_R2
		MOV 34H,#R_G3
		MOV 35H,#R_Y4
		
		MOV TMOD,#61H	;初始化计时器 定时器0方式1 计数器1方式2
		MOV TH0,#1FH	;2^16-57600 = 7936 = 1F00
		MOV TL0,#00H
		MOV TH1,#0F8H
		MOV TL1,#0F8H	;8. 12*2*8*57600=11.0592MHz ;	

		MOV 37H,#0	;初始化当前时间（小时状态）
		;MOV 6EH,#52H	;测试RAM中红绿灯时间表用
		;MOV 6FH,#00H
		LCALL GET_LIGHT_TIME
		MOV R0,#32H	;R0记录信号灯寄存器状态
		MOV R3,30H
		MOV R2,31H
		LCALL CHANGE_LIGHT	;开信号灯
		SETB ET0
		SETB ET1
		SETB EA
		SETB TR0
		SETB TR1
		SJMP $

INT_TO:								;计时器0中断处理程序
		MOV TH0,#1FH 
		MOV TL0,#00H
		CPL P3.5 
		RETI
		
INT_C1:								;计数器1中断处理程序
		PUSH ACC
		MOV 36H,R3
		LCALL SUBBCD
		MOV R3,36H
		MOV 36H,R2
		LCALL SUBBCD
		MOV R2,36H
		CJNE R2,#0F9H,INT_C1_NEXT2
		INC R0
		CJNE R0,#36H,INT_C1_NEXT0
		MOV R0,#32H
		LCALL CHANGE_LIGHT
		MOV R3,30H
		MOV R2,31H
		SJMP INT_C1_EXIT
INT_C1_NEXT0:
		CJNE R0,#34H,INT_C1_NEXT1
		LCALL CHANGE_LIGHT
		MOV R3,31H
		MOV R2,30H
		SJMP INT_C1_EXIT
INT_C1_NEXT1:
		CJNE R0,#35H,INT_C1_NEXT2
		LCALL CHANGE_LIGHT
		MOV A,R3
		XCH A,R2
		SJMP INT_C1_EXIT
INT_C1_NEXT2:
		CJNE R3,#0F9H,INT_C1_EXIT
		INC R0
		LCALL CHANGE_LIGHT
		MOV A,R2
		XCH A,R3
INT_C1_EXIT:
		MOV 38H,R3	   ;送显示
		MOV 39H,#LDD2
		LCALL DISPLAY_NUMBER
		MOV 38H,R2
		MOV 39H,#LDD4
		LCALL DISPLAY_NUMBER
		INC R6	 ;记秒
		CJNE R6,#SECS_PER_MIN,INT_C1_EXIT1
		MOV R6,#00H
		INC R7
INT_C1_EXIT1:
		CJNE R7,#MINS_PER_HOUR,INT_C1_EXIT2
		MOV R7,#00H
		INC 37H
		LCALL GET_LIGHT_TIME
INT_C1_EXIT2:
		POP ACC
		RETI

GET_LIGHT_TIME:							;获取当前红绿灯时间子程序，存入30h和31h
		PUSH DPH
		PUSH DPL
		PUSH ACC
		PUSH PSW
		SETB RS0		         
		MOV DPTR,#TAB_LIGHT_TIME ;读入信号灯延时信息,30H为绿灯，31H为红灯
		MOV A,37H
		RLC A
		MOVC A,@A+DPTR
		MOV 30H,A
		MOV A,37H
		RLC A
		INC A
		MOVC A,@A+DPTR
		MOV 31H,A	
		;检查是否有用户自定义数据
		MOV A,37H
		RLC A
		ADD A,#40H
		MOV R0,A
		INC A
		MOV R1,A
		MOV A,@R0  
		ORL A,@R1
		JZ GET_LIGHT_TIME_EXIT ;若全为零，说明无用户定义数据，直接跳出
		CJNE @R0,#00H,GET_LIGHT_TIME_NEXT1
		AJMP GET_LIGHT_TIME_NEXT2
GET_LIGHT_TIME_NEXT1:
		MOV 30H,@R0
GET_LIGHT_TIME_NEXT2:
		CJNE @R1,#00H,GET_LIGHT_TIME_NEXT3
		AJMP GET_LIGHT_TIME_FILL1
GET_LIGHT_TIME_NEXT3:
		MOV 31H,@R1
GET_LIGHT_TIME_FILL1:
		MOV A,@R0 ;检查用户定义数据是否完整，不完整则以默认数据补充(默认为，红灯比绿灯长3秒) 
		ANL A,@R1
		JNZ GET_LIGHT_TIME_EXIT	;若有一个为零，则更改其为默认值
		CJNE @R0,#00H,GET_LIGHT_TIME_FILL2
		MOV 36H,@R1
		LCALL SUBBCD
		LCALL SUBBCD
		LCALL SUBBCD
		MOV 30H,36H
GET_LIGHT_TIME_FILL2:
		CJNE @R1,#00H,GET_LIGHT_TIME_EXIT
		MOV A,@R0
		CLR CY
		ADD A,#3
		DA A
		MOV 31H,A
GET_LIGHT_TIME_EXIT:
		CLR RS0
		POP PSW
		POP ACC
		POP DPL
		POP DPH
		RETI

CHANGE_LIGHT:				;开信号灯子程序
		PUSH DPH
		PUSH ACC
		MOV DPH,#LED
		MOV A,@R0
		MOVX @DPTR,A
		POP ACC
		POP DPH
		RET

DISPLAY_NUMBER:				;显示倒计时数字子程序，显示38H中的数字到39H指定的地址中 先显示低位，再显示高位
		PUSH ACC
		MOV A,38H
		ANL 38H,#0FH
		LCALL GETDIGIT
		MOV DPH,39H
		LCALL DISDIGIT
		SWAP A
		MOV 38H,A
		ANL 38H,#0FH
		LCALL GETDIGIT
		DEC 39H
		MOV DPH,39H
		LCALL DISDIGIT
		POP ACC
		RET

GETDIGIT:					;取段码子程序
		PUSH DPH
		PUSH DPL
		PUSH ACC
		MOV DPTR,#DIGIT
		MOV A,38H
		MOVC A,@A+DPTR
		XCH A,38H
		POP ACC
		POP DPL
		POP DPH
		RET
				
DISDIGIT:					;送数码管显示子程序
		PUSH ACC
		MOV	A,38H
		MOVX @DPTR,A
		POP ACC 
		RET

SUBBCD:						;BCD码减一,对36H中的数做BCD码减1
		PUSH ACC
		PUSH PSW
		DEC 36H
		MOV A,36H
		ANL A,#0FH
		CJNE A,#0FH,SUBBCD_EXIT
		CLR CY
		MOV A,36H
		SUBB A,#06
		MOV 36H,A
SUBBCD_EXIT:
		POP PSW
		POP ACC
		RETI
			                 
DIGIT:							;LED数码管段码表
		DB 3FH,06H,5BH,4FH,66H
		DB 6DH,7DH,07H,7FH,6FH
		DB 77H,7CH,39H,5EH,79H,71H
TAB_LIGHT_TIME:  				;预设的信号灯时间常数，共24行，48个值
		DB 02H, 05H
		DB 11H, 14H
		DB 03H, 06H
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		DB 24H, 26H
;end-----------------------------
END