;;------------------------
;;TrafLight v1.0
;;by SN icetiny@gmail.com
;;2011-6-7
;;------------------------
;;R0	 R1			  R2			  R3 					R7
;;灯状态 临时使用 2红灯倒计时	  绿灯倒计时    临时使用
;;------------------------
;;30H  31H  32H-35H	   36H            37H				38H			  40H-6FH
;;绿灯 红灯	灯状态地址 当前秒状态数码 当前小时状态码  LED显示寄存器	  用户定义灯状态
;;------------------------
		ORG 0000H
		AJMP MAIN
;INTERRUPT VECTORS
		ORG 000BH							
		AJMP INT_TO							
		;ORG 0013H							
		;AJMP INT_EX1							
		ORG 001BH							
		AJMP INT_C1							
;DEFINE CONSTANT VALUE
		LDD1 EQU 00H ;数码管地址
		LDD2 EQU 01H
		LDD3 EQU 02H
		LDD4 EQU 03H
		LDD5 EQU 04H
		LDD6 EQU 05H
		LED  EQU 06H ;灯地址
		G_R1 EQU 1100B
		Y_R2 EQU 1010B
		R_G3 EQU 100001B
		R_Y4 EQU 10001B																							
	
;MAIN PROGRAM BEGIN
		ORG 0030H
MAIN:	
		MOV SP,#10H
		MOV 32H,#G_R1
		MOV 33H,#Y_R2
		MOV 34H,#R_G3
		MOV 35H,#R_Y4
		
		MOV TMOD,#61H ;初始化计时器 定时器0方式1 计数器1方式2
		MOV TH0,#1FH ;2^16-57600 = 7936 = 1F00
		MOV TL0,#00H
		MOV TH1,#0F8H
		MOV TL1,#0F8H ;8. 12*2*8*57600=11.0592MHz ;	

		MOV 37H,#23			;初始化当前时间（小时状态）
		;MOV 6EH,#50H		;测试RAM中红绿灯时间表用
		;MOV 6FH,#52H
		LCALL GET_LIGHT_TIME
		MOV R0,#32H	   		;R0记录信号灯寄存器状态
		MOV R3,30H
		MOV R2,31H
		LCALL CHANGE_LIGHT  ;开信号灯   
		LCALL DISPLAY_NUMBER
		SETB ET0
		SETB ET1
		SETB EA
		SETB TR0
		SETB TR1
		SJMP $

INT_TO:				;计时器0中断处理程序
		MOV TH0,#1FH 
		MOV TL0,#00H
		CPL P3.5 
		RETI
		
INT_C1:				;计数器1中断处理程序
		PUSH ACC
		LCALL SUBBCD
		CJNE R2,#0F9H,INT_C1_NEXT2
		INC R0
		CJNE R0,#36H,INT_C1_NEXT0
		MOV R0,#32H
		LCALL CHANGE_LIGHT
		MOV R3,30H
		MOV R2,31H
		SJMP INT_C1_EXIT
INT_C1_NEXT0:
		CJNE R0,#34H,INT_C1_NEXT1
		LCALL CHANGE_LIGHT
		MOV R3,31H
		MOV R2,30H
		SJMP INT_C1_EXIT
INT_C1_NEXT1:
		CJNE R0,#35H,INT_C1_NEXT2
		LCALL CHANGE_LIGHT
		MOV A,R3
		XCH A,R2
		SJMP INT_C1_EXIT
INT_C1_NEXT2:
		CJNE R3,#0F9H,INT_C1_EXIT
		INC R0
		LCALL CHANGE_LIGHT
		MOV A,R2
		XCH A,R3
INT_C1_EXIT:
		POP ACC
		LCALL DISPLAY_NUMBER
		RETI

GET_LIGHT_TIME:			;获取当前红绿灯时间子程序，存入30h和31h
		PUSH DPH
		PUSH DPL
		PUSH ACC		         
		MOV DPTR,#TAB_LIGHT_TIME ;读入信号灯延时信息,30H为绿灯，31H为红灯
		MOV A,37H
		RLC A
		MOVC A,@A+DPTR
		MOV 30H,A
		MOV A,37H
		RLC A
		INC A
		MOVC A,@A+DPTR
		MOV 31H,A	
		;检查是否有用户自定义数据
		MOV A,37H
		RLC A
		ADD A,#40H
		MOV R1,A
		CJNE @R1,#00H,GET_LIGHT_TIME_NEXT1
		AJMP GET_LIGHT_TIME_EXIT
GET_LIGHT_TIME_NEXT1:
		MOV 30H,@R1
		INC A
		MOV R1,A
		CJNE @R1,#00H,GET_LIGHT_TIME_NEXT2
		AJMP GET_LIGHT_TIME_EXIT
GET_LIGHT_TIME_NEXT2:
		MOV 31H,@R1
GET_LIGHT_TIME_EXIT:
		POP ACC
		POP DPL
		POP DPH
		RETI

CHANGE_LIGHT:				;开信号灯子程序
		PUSH DPH
		PUSH ACC
		MOV DPH,#LED
		MOV A,@R0
		MOVX @DPTR,A
		POP ACC
		POP DPH
		RET

DISPLAY_NUMBER:				;显示倒计时数字子程序
		PUSH DPH
		PUSH ACC
		MOV A,R3			;处理R3
		ADD A,#0
		DA A
		MOV 38H,A
		ANL 38H,#0FH
		LCALL GETDIGIT
		MOV DPH,#LDD2
		LCALL DISDIGIT
		SWAP A
		MOV 38H,A
		ANL 38H,#0FH
		LCALL GETDIGIT
		MOV DPH,#LDD1
		LCALL DISDIGIT
		MOV A,R2			;处理R2
		ADD A,#0
		DA A
		MOV 38H,A
		ANL 38H,#0FH
		LCALL GETDIGIT
		MOV DPH,#LDD4
		LCALL DISDIGIT
		SWAP A
		MOV 38H,A
		ANL 38H,#0FH
		LCALL GETDIGIT
		MOV DPH,#LDD3
		LCALL DISDIGIT
		POP ACC
		POP DPH
		RET

GETDIGIT:				;取段码子程序
		PUSH DPH
		PUSH DPL
		PUSH ACC
		MOV DPTR,#DIGIT
		MOV A,38H
		MOVC A,@A+DPTR
		XCH A,38H
		POP ACC
		POP DPL
		POP DPH
		RET
				
DISDIGIT:				;送数码管显示子程序
		PUSH ACC
		MOV	A,38H
		MOVX @DPTR,A
		POP ACC 
		RET

SUBBCD:				;BCD码减一,对R3,R2中的两个倒计时减1
		PUSH ACC
		PUSH PSW
		DEC R3
		MOV A,R3
		ANL A,#0FH
		CJNE A,#0FH,SUBBCD_NEXT
		CLR CY
		MOV A,R3
		SUBB A,#06
		MOV R3,A
SUBBCD_NEXT:
		DEC R2
		MOV A,R2
		ANL A,#0FH
		CJNE A,#0FH,SUBBCD_EXIT
		CLR CY
		MOV A,R2
		SUBB A,#06
		MOV R2,A
SUBBCD_EXIT:
		POP PSW
		POP ACC
		RETI
			                 
DIGIT:
		DB 3FH,06H,5BH,4FH,66H
		DB 6DH,7DH,07H,7FH,6FH
		DB 77H,7CH,39H,5EH,79H,71H
TAB_LIGHT_TIME:  ;预设的信号灯时间常数，共24行，48个值
		DB 01H, 03H
		DB 02H, 04H
		DB 03H, 05H
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		DB 24H, 26H
;end-----------------------------
END